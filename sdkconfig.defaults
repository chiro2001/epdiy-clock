## sdkconfig.defaults
```kconfig
CONFIG_LWIP_SNTP_MAX_SERVERS=3

CONFIG_SPIRAM=y
CONFIG_SPIRAM_BANKSWITCH_ENABLE=y
CONFIG_SPIRAM_BANKSWITCH_RESERVE=48

CONFIG_TASK_WDT_TIMEOUT_S=10

CONFIG_MBEDTLS_HAVE_TIME_DATE=y
```
